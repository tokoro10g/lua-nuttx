## Kconfig
```kconfig
config MYAPPS_LUA
	bool "Lua"
	default n
	---help---
		Enable the lua app

if MYAPPS_LUA

config MYAPPS_LUA_PROGNAME
	string "Program name"
	default "lua"
	depends on BUILD_KERNEL
	---help---
		This is the name of the program that will be use when the NSH ELF
		program is installed.

config MYAPPS_LUA_PRIORITY
	int "lua task priority"
	default 100

config MYAPPS_LUA_STACKSIZE
	int "lua stack size"
	default 32768

endif
```
